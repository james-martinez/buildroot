## configs/raspberrypi3_lancer_defconfig
```kconfig
BR2_arm=y
BR2_cortex_a53=y
BR2_ARM_FPU_NEON_VFPV4=y
BR2_TOOLCHAIN_EXTERNAL=y
BR2_TOOLCHAIN_EXTERNAL_CUSTOM=y
BR2_TOOLCHAIN_EXTERNAL_PATH="/usr/local/xtools/armv8-cortexa53-linux-gnueabihf"
BR2_TOOLCHAIN_EXTERNAL_CUSTOM_PREFIX="armv8-cortexa53-linux-gnueabihf"
BR2_TOOLCHAIN_EXTERNAL_GCC_4_9=y
BR2_TOOLCHAIN_EXTERNAL_HEADERS_4_9=y
BR2_TOOLCHAIN_EXTERNAL_CUSTOM_GLIBC=y
BR2_TOOLCHAIN_EXTERNAL_CXX=y
BR2_TARGET_GENERIC_HOSTNAME="Lancer"
BR2_TARGET_GENERIC_ISSUE="Welcome to Lancer"
BR2_TARGET_GENERIC_ROOT_PASSWD="thIs*is*not-the_p@ssw0rd"
# BR2_TARGET_GENERIC_REMOUNT_ROOTFS_RW is not set
BR2_SYSTEM_DHCP="eth0"
BR2_ROOTFS_POST_BUILD_SCRIPT="board/raspberrypi3/lancer/config/buildroot_postscript.sh"
BR2_ROOTFS_POST_IMAGE_SCRIPT="board/raspberrypi/lancer/rpi/genboottar.sh"
BR2_LINUX_KERNEL=y
BR2_LINUX_KERNEL_CUSTOM_TARBALL=y
BR2_LINUX_KERNEL_CUSTOM_TARBALL_LOCATION="$(call github,raspberrypi,linux,c117a8bccf37bfba323065b566cf999ed4629a4a)/linux-c117a8bccf37bfba323065b566cf999ed4629a4a.tar.gz"
BR2_LINUX_KERNEL_DEFCONFIG="bcm2709"
BR2_LINUX_KERNEL_DTS_SUPPORT=y
BR2_LINUX_KERNEL_INTREE_DTS_NAME="bcm2710-rpi-3-b bcm2710-rpi-3-b-plus bcm2710-rpi-cm3"
BR2_PACKAGE_RPI_FIRMWARE=y
BR2_PACKAGE_HOST_DOSFSTOOLS=y
BR2_PACKAGE_HOST_E2FSPROGS=y
BR2_PACKAGE_HOST_GENIMAGE=y
BR2_PACKAGE_HOST_MTOOLS=y
```

## package/aws-cpp-sdk/Config.in
```kconfig
config BR2_PACKAGE_AWS_CPP_SDK
	bool "aws-cpp-sdk"
	select BR2_USE_ZLIB
	select BR2_USE_OPENSSL
	select  BR2_USE_LIBCURL
	help
	 The AWS SDK for C++ provides a modern
	 C++ (version C++ 11 or later) interface for
	 Amazon Web Services (AWS)

	 https://github.com/aws/aws-sdk-cpp
```

## package/aws-iot-sdk-cpp/Config.in
```kconfig
config BR2_PACKAGE_AWS_IOT_SDK_CPP
	bool "aws-iot-sdk-cpp"
	select BR2_USE_OPENSSL
	help
	 SDK for connecting to AWS IoT from a device 
         using C++

	 https://github.com/aws/aws-iot-device-sdk-cpp/
```

## package/libaws-cpp-sdk/Config.in
```kconfig
config BR2_PACKAGE_LIBAWS_CPP_SDK
	bool "libaws-cpp-sdk"
	select BR2_USE_ZLIB
	select BR2_USE_OPENSSL
	select  BR2_USE_LIBCURL
	help
	 The AWS SDK for C++ provides a modern
	 C++ (version C++ 11 or later) interface for
	 Amazon Web Services (AWS)

	 https://github.com/aws/aws-sdk-cpp
```

## package/libp11/Config.in
```kconfig
config BR2_PACKAGE_LIBP11
	bool "libp11"
select BR2_PACKAGE_OPENSSL
	help
	 libp11 provides a higher-level (compared to the PKCS#11 library) interface to access PKCS#11 objects. It is designed to integrate with applications that use OpenSSL.
	 pkcs11 engine plugin for the OpenSSL library allows accessing PKCS#11 modules in a semi-transparent way.
         https://github.com/OpenSC/libp11
```

## package/openct/Config.in
```kconfig
config BR2_PACKAGE_OPENCT
	bool "openct"
	help
	  OpenCT implements drivers for several smart card readers
          https://github.com/OpenSC/openct

select BR2_PACKAGE_LIBTOOL
select BR2_PACKAGE_LIBUSB_COMPAT
```

## package/opensc/Config.in
```kconfig
config BR2_PACKAGE_OPENSC
	bool "opensc"
	help
	 Open source smart card tools and middleware. PKCS#11/MiniDriver/Tokend
         https://github.com/OpenSC/OpenSC/

select BR2_PACKAGE_OPENSSL

if BR2_PACKAGE_OPENSC

config BR2_OPENSC_PACKAGE_PCSC_LITE
	bool "pcsc-lite support"
	select  BR2_PACKAGE_PCSC_LITE
	help 
	use pcsc-lite

config BR2_OPENSC_PACKAGE_OPENCT
	bool "openct support"
	select  BR2_PACKAGE_OPENCT
	help 
	use openct

endif
```

## package/pkcs11-helper/Config.in
```kconfig
config BR2_PACKAGE_PKCS11_HELPER
	bool "pkcs11-helper"
	depends on !BR2_PREFER_STATIC_LIB
	depends on BR2_USE_MMU
	depends on BR2_TOOLCHAIN_HAS_THREADS
	help
	PKCS#11 is published standard. PKCS#11 is the de-facto standard to
	access cryptographic devices.

	pkcs11-helper is a library that simplifies the interaction with
	PKCS#11 providers for end-user applications.

	  https://github.com/OpenSC/pkcs11-helper

comment "pkcs11-kit needs a toolchain w/ threads, dynamic library"
	depends on BR2_USE_MMU
	depends on !BR2_TOOLCHAIN_HAS_THREADS || BR2_PREFER_STATIC_LIB
```
