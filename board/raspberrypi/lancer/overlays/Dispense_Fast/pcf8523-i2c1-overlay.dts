// Definition for pcf8523 I2C based Real Time Clock
// Available through i2c1
/dts-v1/;
/plugin/;

/ {
	compatible = "brcm,bcm2708";
	
	fragment@1 {
		target = <&i2c1>;
		__dormant__ {
			#address-cells = <1>;
			#size-cells = <0>;
			status = "okay";

			pcf8563: pcf8563@51 {
				compatible = "nxp,pcf8563";
				reg = <0x51>;
				status = "okay";
		};
	};
};
